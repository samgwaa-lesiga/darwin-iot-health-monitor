/*
  Sketch generated by the Arduino IoT Cloud Thing "Untitled 20"
  Refined for MKR IoT Carrier + Pulse Sensor + Accelerometer GForce Display
*/

#include "thingProperties.h"
#include <Arduino_MKRIoTCarrier.h>
#include <PulseSensorPlayground.h>
#include <Arduino_LSM6DS3.h>   // Accelerometer library (LSM6DS3)

const int PulseSensorPurplePin = A5; 
const int LED = LED_BUILTIN; 
int Threshold = 580;

int Signal;  

MKRIoTCarrier carrier;

void setup() {
  Serial.begin(115200);
  pinMode(LED, OUTPUT);

  initProperties();
  ArduinoCloud.begin(ArduinoIoTPreferredConnection);
  setDebugMessageLevel(2);
  ArduinoCloud.printDebugInfo();

  // Initialize Carrier
  carrier.begin();

  // Screen boot text
  carrier.display.fillScreen(ST77XX_BLACK);
  carrier.display.setTextColor(ST77XX_YELLOW);
  carrier.display.setTextSize(2);
  carrier.display.setCursor(20, 60);
  carrier.display.print("Pulse + IMU");
  carrier.display.setCursor(20, 100);
  carrier.display.print("Starting...");

  // Initialize IMU
  if (!IMU.begin()) {
    carrier.display.setCursor(20, 140);
    carrier.display.setTextColor(ST77XX_RED);
    carrier.display.print("IMU FAIL");
    while (1);
  }

  carrier.display.setCursor(20, 140);
  carrier.display.setTextColor(ST77XX_GREEN);
  carrier.display.print("IMU OK");

  // Wait for cloud connection
  while (!ArduinoCloud.connected()) {
    ArduinoCloud.update();
    delay(500);
  }

  delay(2000);

  systemOn = true;
  pulseSensor = true;
  ArduinoCloud.update();
  onSystemOnChange();
}



void loop() {
  ArduinoCloud.update();

  if (systemOn) {

    // ---------------------------
    // Pulse Sensor Reading
    // ---------------------------
    Signal = analogRead(PulseSensorPurplePin); 
    Serial.println("Signal " + String(Signal));

    if (Signal > Threshold) {
      digitalWrite(LED, HIGH);
    } else {
      digitalWrite(LED, LOW);
    }


    // ---------------------------
    // Accelerometer GForce Value
    // ---------------------------
    float x, y, z;

    if (IMU.accelerationAvailable()) {
      IMU.readAcceleration(x, y, z);

      float magnitude = sqrt(x*x + y*y + z*z) - 1.0;  
      if (magnitude < 0) magnitude = 0;
      if (magnitude > 3) magnitude = 3;

      float gForceValue = magnitude * 100.0; 

      Serial.println("GForce: " + String(gForceValue));

      // ---------------------------
      // Display GForce on Screen
      // ---------------------------
      carrier.display.fillRect(0, 180, 240, 40, ST77XX_BLACK);
      carrier.display.setCursor(20, 190);
      carrier.display.setTextColor(ST77XX_CYAN);
      carrier.display.print("gForce: ");
      carrier.display.print(gForceValue, 1);


      // ---------------------------
      // LED Ring Visualization
      // ---------------------------
      carrier.leds.clear();   // turn all LEDs off

      int ledsToLight = map(gForceValue, 0, 300, 0, 12);  
      if (ledsToLight > 12) ledsToLight = 12;

      for (int i = 0; i < ledsToLight; i++) {
        carrier.leds.setPixelColor(i, 0, 80, 200); // Blue-cyan glow
      }

      carrier.leds.show();
    }
  }

  delay(20);
}



void onSystemOnChange() {
  // Clear the status area
  carrier.display.fillRect(20, 140, 200, 20, ST77XX_BLACK);

  carrier.display.setCursor(20, 140);

  if (systemOn == true) {
    // Display ON message
    carrier.display.setTextColor(ST77XX_GREEN);
    carrier.display.print("SYSTEM ON");

    // ---------- BUZZER: 1 beep ----------
    carrier.Buzzer.sound(1000);
    delay(100);
    carrier.Buzzer.noSound();

  } else {
    // Display OFF message
    carrier.display.setTextColor(ST77XX_RED);
    carrier.display.print("SYSTEM OFF");

    // ---------- BUZZER: 2 beeps ----------
    for (int i = 0; i < 2; i++) {
      carrier.Buzzer.sound(1000);
      delay(100);
      carrier.Buzzer.noSound();
      delay(100);
    }
  }
}
