/*
  Sketch generated by the Arduino IoT Cloud Thing "Untitled 20"
  Refined for MKR IoT Carrier + Pulse Sensor
*/

#include "thingProperties.h"
#include <Arduino_MKRIoTCarrier.h>
#include <PulseSensorPlayground.h>

// --- CONFIGURATION ---
// On the MKR IoT Carrier, use the Grove connector labeled A5 or A6.
// A0 is not accessible on the carrier's external connectors.
const int PulseSensorPurplePin = A5; 
const int LED = LED_BUILTIN; 
int Threshold = 580;   // Determine which Signal to "count as a beat"

int Signal;  // Holds the incoming raw data (0-1024)

MKRIoTCarrier carrier;

void setup() {
  // Initialize serial and pins
  Serial.begin(115200);
  pinMode(LED, OUTPUT);

  // Initialize Arduino IoT Cloud properties
  initProperties();
  ArduinoCloud.begin(ArduinoIoTPreferredConnection);
  setDebugMessageLevel(2);
  ArduinoCloud.printDebugInfo();

  // Initialize the Carrier
  carrier.begin();

  // Setup the Screen
  carrier.display.fillScreen(ST77XX_BLACK);
  carrier.display.setTextColor(ST77XX_YELLOW);
  carrier.display.setTextSize(2);
  carrier.display.setCursor(20, 60);
  carrier.display.print("Pulse Sensor");
  carrier.display.setCursor(20, 100);
  carrier.display.print("Ready...");

  while (ArduinoCloud.connected() != 1) {
    ArduinoCloud.update();
    delay(500);
  }

  // Force sync and set value
  delay(2000);  // Wait for full sync
  systemOn = true;
  ArduinoCloud.update();  // Push to cloud immediately
  onSystemOnChange();
  
}

void loop() {
  // Keep the cloud connection alive
  ArduinoCloud.update();
  
  // Only run pulse sensor when system is ON
  if (systemOn) {
    // Read the Sensor
    Signal = analogRead(PulseSensorPurplePin); 

    // Send to Serial Plotter
    Serial.println("Signal " + String(Signal)); 

    // Blink LED and Update Screen
    if(Signal > Threshold){
      digitalWrite(LED, HIGH);
      carrier.display.fillCircle(120, 120, 20, ST77XX_RED); 
    } else {
      digitalWrite(LED, LOW);
      carrier.display.fillCircle(120, 120, 20, ST77XX_BLACK); 
    }
  }
  delay(20);
}

void onSystemOnChange() {
   // Clear the status area first
  carrier.display.fillRect(20, 140, 200, 20, ST77XX_BLACK);

   // Set cursor and write new status
  carrier.display.setCursor(20, 140);
  if (systemOn = true) {
    carrier.display.setTextColor(ST77XX_GREEN);
    carrier.display.print("SYSTEM ON ");
  } else {
    carrier.display.setTextColor(ST77XX_RED);
    carrier.display.print("SYSTEM OFF");
  }
}